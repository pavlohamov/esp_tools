## test/sdkconfig.defaults
```kconfig
CONFIG_COMPILER_OPTIMIZATION_SIZE=y
CONFIG_FREERTOS_HZ=1000
CONFIG_FREERTOS_CORETIMER_1=y
CONFIG_FREERTOS_USE_TRACE_FACILITY=y
CONFIG_LWIP_TCPIP_TASK_STACK_SIZE=4096
CONFIG_LWIP_IRAM_OPTIMIZATION=y
CONFIG_ESP_MAIN_TASK_STACK_SIZE=12288
CONFIG_ESP_SYSTEM_EVENT_TASK_STACK_SIZE=3072
CONFIG_ESP_XT_WDT=y

CONFIG_PM_ENABLE=y

CONFIG_ADC_CONTINUOUS_ISR_IRAM_SAFE=y

CONFIG_ESP_WIFI_FTM_ENABLE=y

CONFIG_SPIRAM_TRY_ALLOCATE_WIFI_LWIP=y
CONFIG_SPIRAM_ALLOW_BSS_SEG_EXTERNAL_MEMORY=y
CONFIG_SPIRAM_MALLOC_ALWAYSINTERNAL=0
# task's stacks are also here
CONFIG_SPIRAM_MALLOC_RESERVE_INTERNAL=98304

CONFIG_RTC_CLK_SRC_INT_RC=y
CONFIG_ESP_DEFAULT_CPU_FREQ_MHZ_240=y

CONFIG_ESP_WIFI_SLP_IRAM_OPT=y

#todo: put data into phy_init instaed of nvs
CONFIG_ESP_PHY_CALIBRATION_AND_DATA_STORAGE=n
CONFIG_ESP_PHY_INIT_DATA_IN_PARTITION=y
CONFIG_ESP_PHY_DEFAULT_INIT_IF_INVALID=y

CONFIG_ETH_USE_SPI_ETHERNET=n

CONFIG_HEAP_ABORT_WHEN_ALLOCATION_FAILS=y

CONFIG_MBEDTLS_TLS_CLIENT_ONLY=y
CONFIG_MBEDTLS_EXTERNAL_MEM_ALLOC=y
CONFIG_MBEDTLS_DYNAMIC_BUFFER=y
CONFIG_MBEDTLS_SSL_OUT_CONTENT_LEN=16384

CONFIG_BOOTLOADER_APP_ROLLBACK_ENABLE=y

CONFIG_APP_PROJECT_VER_FROM_CONFIG=y
CONFIG_APP_PROJECT_VER="${VERSION}"

CONFIG_TWAI_ISR_IN_IRAM=y
CONFIG_UART_ISR_IN_IRAM=y
CONFIG_SPI_MASTER_IN_IRAM=y
CONFIG_SPI_SLAVE_ISR_IN_IRAM=n

CONFIG_I2S_ISR_IRAM_SAFE=y

#CONFIG_ESP_CONSOLE_USB_SERIAL_JTAG=y
CONFIG_ESP_CONSOLE_UART_DEFAULT=y
#CONFIG_ESP_CONSOLE_USB_CDC=y


# CONFIG_BT_BLE_50_FEATURES_SUPPORTED is not set
CONFIG_BT_BLE_42_FEATURES_SUPPORTED=y
CONFIG_BT_ENABLED=y
CONFIG_BT_GATTC_ENABLE=n
CONFIG_BT_BLE_SMP_ENABLE=n
CONFIG_BT_BLE_BLUFI_ENABLE=y


CONFIG_COMPILER_STACK_CHECK_MODE_STRONG=y
CONFIG_COMPILER_OPTIMIZATION_ASSERTIONS_ENABLE=y
CONFIG_COMPILER_OPTIMIZATION_CHECKS_SILENT=n
CONFIG_COMPILER_WARN_WRITE_STRINGS=y
CONFIG_HEAP_TASK_TRACKING=y
CONFIG_HEAP_TRACING_STANDALONE=y
CONFIG_HEAP_POISONING_COMPREHENSIVE=y
CONFIG_ESP_COREDUMP_ENABLE_TO_UART=y

CONFIG_FREERTOS_USE_STATS_FORMATTING_FUNCTIONS=y
CONFIG_FREERTOS_GENERATE_RUN_TIME_STATS=y
CONFIG_FREERTOS_CHECK_STACKOVERFLOW_PTRVAL=y
CONFIG_FREERTOS_WATCHPOINT_END_OF_STACK=y
CONFIG_FREERTOS_INTERRUPT_BACKTRACE=y
CONFIG_FREERTOS_CHECK_MUTEX_GIVEN_BY_OWNER=y

CONFIG_LOG_DEFAULT_LEVEL_INFO=y
CONFIG_LOG_MAXIMUM_LEVEL_VERBOSE=y



#CONFIG_ESP_SYSTEM_GDBSTUB_RUNTIME=y
CONFIG_ESP_DEBUG_STUBS_ENABLE=n
CONFIG_ESP_TASK_WDT_PANIC=y
CONFIG_ESP_TASK_WDT_TIMEOUT_S=15
CONFIG_ESP_PANIC_HANDLER_IRAM=y
CONFIG_ESP_HTTPS_OTA_ALLOW_HTTP=y

CONFIG_SECURE_INSECURE_ALLOW_DL_MODE=y
CONFIG_SECURE_BOOT_INSECURE=y
CONFIG_SECURE_BOOT_ALLOW_UNUSED_DIGEST_SLOTS=y
CONFIG_SECURE_BOOT_ALLOW_JTAG=y
CONFIG_SECURE_FLASH_ENCRYPTION_MODE_DEVELOPMENT=y
CONFIG_SECURE_FLASH_UART_BOOTLOADER_ALLOW_CACHE=y


#do not modify eFuse permanently
CONFIG_EFUSE_VIRTUAL=y
CONFIG_EFUSE_VIRTUAL_KEEP_IN_FLASH=n
#on if virtual
CONFIG_BOOT_ROM_LOG_ALWAYS_ON=y



CONFIG_ESPTOOLPY_HEADER_FLASHSIZE_UPDATE=y
CONFIG_ESPTOOLPY_FLASHSIZE_4MB=y
CONFIG_ESPTOOLPY_FLASHMODE_QIO=y
CONFIG_ESPTOOLPY_FLASHFREQ_80M=y

#CONFIG_ESP32S2_INSTRUCTION_CACHE_16KB=y
#CONFIG_ESP32S2_DATA_CACHE_16KB=y
#CONFIG_ESP32S2_DEBUG_STUBS_ENABLE=y

#CONFIG_SPIRAM=y
#CONFIG_SPIRAM_SPEED_80M=y

CONFIG_RTC_CLK_SRC_INT_RC=y

CONFIG_UART_ISR_IN_IRAM=n
CONFIG_SPI_MASTER_IN_IRAM=n
CONFIG_SPI_SLAVE_ISR_IN_IRAM=n

CONFIG_I2S_ISR_IRAM_SAFE=n

CONFIG_ADC_CONTINUOUS_ISR_IRAM_SAFE=n

CONFIG_ESP_WIFI_SLP_IRAM_OPT=n
```
